/* source key position labels */
#include "zmk-helpers/key-labels/36.h"

/* map chocofi's extra keys */
#define X_LH  &kp LGUI      // thumb row, left
#define X_RH  &smart_mouse  // thumb row, right

/* activate bluetooth */
#define CONFIG_WIRELESS 1

/* use LINUX unicode */
#define HOST_OS 1

/* source the main keymap */
#include "base.keymap"

/* use 5-column layout for chocofi */
ZMK_APPLY_MATRIX_TRANSFORM(default_transform)
